## linux-kernel/drivers/pinctrl/novatek/Kconfig
```kconfig
if MACH_NVT_NA51000

config PINCTRL_NA51000
	bool "Novatek NA51000 pin control"
	depends on OF
	default MACH_NVT_NA51000
endif
```

## linux-kernel/drivers/soc/nvt/Kconfig
```kconfig
#
# NVT SOC drivers
#
menu "NVT SoC drivers"

config NVT_PROFILER
	bool "Novatek Profilers"
	depends on ARCH_NVT_IVOT_V7
	depends on ARM || ARM64
	select KPROBES
	select KRETPROBES
	select EVENT_TRACING
	select TRACING_SUPPORT
	select FTRACE
	select FUNCTION_TRACER
	default y

endmenu
```
